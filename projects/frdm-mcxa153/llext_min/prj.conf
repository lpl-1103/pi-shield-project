## CMakeLists.txt
```
cmake_minimum_required(VERSION 3.20.0)
find_package(Zephyr REQUIRED HINTS $ENV{ZEPHYR_BASE})
project(llext_min)

target_sources(app PRIVATE src/main.c)
```

## prj.conf
```kconfig
# Minimal shell, just enough for the llext command tree
CONFIG_SHELL=y
CONFIG_SHELL_CMD_BUFF_SIZE=4224
CONFIG_SHELL_STACK_SIZE=1536
CONFIG_SHELL_BACKEND_SERIAL_TX_RING_BUFFER_SIZE=128
CONFIG_SHELL_BACKEND_SERIAL_RX_RING_BUFFER_SIZE=128
CONFIG_SHELL_HELP=n
CONFIG_SHELL_STATS=n
CONFIG_SHELL_HISTORY=n
CONFIG_SHELL_WILDCARD=n

# No logging: it costs RAM and we don't need it for this experiment
CONFIG_LOG=n

# LLEXT itself
CONFIG_LLEXT=y
CONFIG_LLEXT_SHELL=y
CONFIG_LLEXT_HEAP_SIZE=4
CONFIG_LLEXT_SHELL_MAX_SIZE=2048
CONFIG_LLEXT_IMPORT_ALL_GLOBALS=y
```

## src/main.c
```c
#include <zephyr/kernel.h>
#include <zephyr/sys/printk.h>

int main(void)
{
	printk("llext_min ready. Use 'llext' shell commands to load code.\n");
	return 0;
}
```
